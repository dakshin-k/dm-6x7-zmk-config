## config/boards/shields/dactyl_manuform_6x7/Kconfig.shield
```kconfig
config SHIELD_DACTYL_MANUFORM_6x7_LEFT
    def_bool $(shields_list_contains,dactyl_manuform_6x7_left)

config SHIELD_DACTYL_MANUFORM_6x7_RIGHT
    def_bool $(shields_list_contains,dactyl_manuform_6x7_right)
```
